/*
 * Copyright (c) 2017  The Linux Foundation. All rights reserved.
 *
 * This program is free software; you can redistribute it and/or modify
 * it under the terms of the GNU General Public License version 2 and
 * only version 2 as published by the Free Software Foundation.
 *
 * This program is distributed in the hope that it will be useful,
 * but WITHOUT ANY WARRANTY; without even the implied warranty of
 * MERCHANTABILITY or FITNESS FOR A PARTICULAR PURPOSE.  See the
 * GNU General Public License for more details.
 */

/dts-v1/;

#include "apq8009w-dragonboard.dtsi"

/ {
	model = "Intrinsyc Technologies, Corp. APQ8009W Open-Q 2100 DragonBoard rev.1";
	compatible = "qcom,apq8009-dragon", "qcom,apq8009", "qcom,dragon", "itc,rev1";
	qcom,msm-id = <265 0>, <301 0>;
	qcom,board-id= <10 0x101>;
};
